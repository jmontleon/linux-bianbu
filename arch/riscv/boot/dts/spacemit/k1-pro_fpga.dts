// SPDX-License-Identifier: (GPL-2.0 OR MIT)
/* Copyright (c) 2022 Spacemit, Inc */

/dts-v1/;

#include "k1-pro.dtsi"
/ {
	model = "spacemit k1-pro fpga board";

	memory@0 {
		device_type = "memory";
		reg = <0x0 0x20000000 0x0 0x10000000>;
	};

	chosen {
		bootargs = "earlycon=sbi console=ttyS0,115200n8 debug loglevel=8,initcall_debug=1 rdinit=/init.tmp";
		stdout-path = "serial0:115200n8";
	};
};

&uart0 {
	status = "okay";
};
