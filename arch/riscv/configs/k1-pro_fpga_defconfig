## drivers/media/platform/spacemit/Kconfig
```kconfig
# SPDX-License-Identifier: GPL-2.0-only

comment "Spacemit media platform drivers"

source "drivers/media/platform/spacemit/vpu_k1x/Kconfig"
source "drivers/media/platform/spacemit/camera/Kconfig"
```

## drivers/media/platform/spacemit/camera/Kconfig
```kconfig
# SPDX-License-Identifier: GPL-2.0
#
# SPACEMIT K1X camera configuration
#

comment "SPACEMIT K1X Camera And Video V2"

menuconfig SPACEMIT_K1X_CAMERA_V2
    tristate "SPACEMIT K1X camera and video capture V2 support"
	select MEDIA_CONTROLLER
	select VIDEO_V4L2_SUBDEV_API
    help
	  Say Y here to enable selecting the video adapters for
	  SPACEMIT K1X camera and video v2

config SPACEMIT_K1X_CCIC_V2
    tristate "SPACEMIT K1X CCIC V2 support"
    depends on SPACEMIT_K1X_CAMERA_V2
    help
      Enable support for ccic v2

config SPACEMIT_K1X_VI_V2
    tristate "SPACEMIT K1X VI V2 support"
    select VIDEOBUF2_CORE
    select VIDEOBUF2_V4L2
    select VIDEOBUF2_DMA_CONTIG
    select VIDEOBUF2_DMA_SG
    select SPACEMIT_K1X_CCIC_V2
    depends on SPACEMIT_K1X_CAMERA_V2
    help
      Enable support for vi

config SPACEMIT_K1X_VI_IOMMU
	bool "SPACEMIT K1X VI IOMMU support"
	depends on SPACEMIT_K1X_VI_V2
    help
      Enable support for vi iommu


config SPACEMIT_K1X_ISP_V2
    tristate "SPACEMIT K1X ISP V2 support"
    depends on SPACEMIT_K1X_CAMERA_V2
    help
      Enable support for isp v2

config SPACEMIT_K1X_CPP_V2
    tristate "SPACEMIT K1X CPP V2 support"
    depends on SPACEMIT_K1X_CAMERA_V2
    help
      Enable support for cpp v2

config SPACEMIT_K1X_SENSOR_V2
    tristate "SPACEMIT K1X SENSOR V2 support"
    depends on SPACEMIT_K1X_CAMERA_V2
    help
      Enable support for sensor v2
```

## drivers/media/platform/spacemit/virtual_camera/Kconfig
```kconfig
# SPDX-License-Identifier: GPL-2.0
#
# SPACEMIT K1X camera configuration
#

comment "SPACEMIT K1X Virtual Camera Driver"

menuconfig SPACEMIT_K1X_VIR_CAMERA
    tristate "SPACEMIT K1X virtual camera support"
	select MEDIA_CONTROLLER
	select VIDEO_V4L2_SUBDEV_API
    help
	  Say Y here to enable selecting the video adapters for
	  SPACEMIT K1X virtual camera and video v2

config SPACEMIT_K1X_VIR_CAMERA
    tristate "SPACEMIT K1X VIRTUAL CAMERA support"
    select VIDEOBUF2_CORE
    select VIDEOBUF2_V4L2
    select VIDEOBUF2_DMA_CONTIG
    select VIDEOBUF2_DMA_SG
    select SPACEMIT_K1X_CCIC_V2
    depends on SPACEMIT_K1X_CAMERA_V2
    help
      Enable support for spacemit virtual camera
```

## drivers/media/platform/spacemit/vpu_k1x/Kconfig
```kconfig
config VIDEO_LINLON_K1X
	tristate "Linlon VPU support."
	depends on VIDEO_DEV && SOC_SPACEMIT_K1X
#	depends on VIDEO_V4L2
	select VIDEOBUF2_VMALLOC
	select VIDEOBUF2_CORE
	select DMA_SHARED_BUFFER
	select VIDEOBUF2_MEMOPS
	select VIDEOBUF2_DMA_SG
	default n
	help
	  This enables support for the Linlon VPU family.

config VIDEO_LINLON_FTRACE_K1X
	depends on VIDEO_LINLON_K1X
	bool "Send kernel space logs to ftrace."
	default n
	help
	  Send kernel space logs to ftrace.

config VIDEO_LINLON_PRINT_FILE_K1X
	depends on VIDEO_LINLON_K1X
	bool "Append file and line number to kernel space log messages."
	default y
	help
	  Append file and line number to kernel space log messages.
```

## drivers/media/vpu/Kconfig
```kconfig
config VIDEO_LINLON
	tristate "Linlon VPU support."
	depends on VIDEO_DEV
	select VIDEOBUF2_VMALLOC
	select VIDEOBUF2_CORE
	select DMA_SHARED_BUFFER
	select VIDEOBUF2_MEMOPS
	select VIDEOBUF2_DMA_SG
	default n
	help
		This enables support for the Linlon VPU family.

config VIDEO_LINLON_FTRACE
	depends on VIDEO_LINLON
	bool "Send kernel space logs to ftrace."
	default n
	help
		Send kernel space logs to ftrace.

config VIDEO_LINLON_PRINT_FILE
	depends on VIDEO_LINLON
	bool "Append file and line number to kernel space log messages."
	default y
	help
		Append file and line number to kernel space log messages.
```

## drivers/phy/spacemit/Kconfig
```kconfig
# SPDX-License-Identifier: GPL-2.0
#
# Phy drivers for Spacemit platforms
#
config PHY_SPACEMIT_K1X_COMBPHY
	tristate "Spacemit K1-x USB3&PCIE combo PHY driver"
	depends on OF
	select GENERIC_PHY
	default SOC_SPACEMIT_K1X && USB_DWC3_SPACEMIT
	help
	  USB3 and PCIE Combo PHY Support for Spacemit k1-x Soc
```

## drivers/pinctrl/spacemit/Kconfig
```kconfig
# SPDX-License-Identifier: GPL-2.0-only
config PINCTRL_SPACEMIT
	tristate
	depends on OF
	select GENERIC_PINCTRL_GROUPS
	select GENERIC_PINMUX_FUNCTIONS
	select GENERIC_PINCONF

config PINCTRL_K1PRO
	bool "Spacemit K1PRO pinctrl driver"
	depends on OF
	depends on SOC_SPACEMIT_K1_FPGA
	select PINCTRL_SPACEMIT
	help
	  Say Y here to enable the k1-pro pinctrl driver
```

## drivers/soc/spacemit/Kconfig
```kconfig
# SPDX-License-Identifier: GPL-2.0-only
if SOC_SPACEMIT

#
# spacemit Soc drivers
#
config SPACEMIT_PM_DOMAINS
	bool "Spacemit generic power domain"
	depends on PM
	select PM_GENERIC_DOMAINS
	help
	  Say y here to enable power domain support.
	  In order to meet high performance and low power requirements, a power
	  management unit is designed or saving power.

endif

config SPACEMIT_REBOOT_CONTROL
	tristate "Spacemit k1x reboot handler"
	depends on SOC_SPACEMIT_K1X
	help
	  Spacemit reboot into fastboot mode

source "drivers/soc/spacemit/jpu/Kconfig"
```

## drivers/soc/spacemit/spacemit-rf/Kconfig
```kconfig
#
# Spacemit rfkill driver.
#
config SPACEMIT_RFKILL
  tristate "Spacemit rfkill driver"
  depends on WIRELESS || RFKILL
  help
    Spacemit rfkill driver
```

## sound/soc/spacemit/Kconfig
```kconfig
config SND_SOC_SPACEMIT
	tristate "SoC Audio for SPACEMIT System-on-Chip"
	select SND_SOC_COMPRESS
	select SND_SOC_GENERIC_DMAENGINE_PCM if (SND_SOC && SND)
	help
	  Say Y or M here if you want support for audio on SPACEMIT SoC.

config SPACEMIT_AUDIO_DATA_DEBUG
        bool "Audio Data Dump"
        depends on SND_SOC_SPACEMIT
        help
          Say Y or N here if you want to enable audio data dump function

config SPACEMIT_PLAY_DEBUG
        bool "Audio Playback Debug"
        depends on SPACEMIT_AUDIO_DATA_DEBUG
        help
          Say Y or N here if you want to open playback debug

config SPACEMIT_CAPT_DEBUG
        bool "Audio Capture Debug"
        depends on SPACEMIT_AUDIO_DATA_DEBUG
        help
          Say Y or N here if you want to open capture debug

config  ADD_WAV_HEADER
        bool "Dump File Adds Wave Header"
        depends on SPACEMIT_AUDIO_DATA_DEBUG
        help
          Say Y or N here if you want to add wave header to dump file
```
